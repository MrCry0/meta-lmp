## meta-lmp-bsp/conf/machine/imx7ulp-evk.conf
```bitbake
#@TYPE: Machine
#@NAME: NXP i.MX7 ULP EVK Board
#@SOC: i.MX7D
#@DESCRIPTION: Machine configuration for NXP i.MX7 ULP EVK Board
#@MAINTAINER: Oleksandr Suvorov <oleksandr.suvorov@foundries.io>

MACHINEOVERRIDES =. "mx7:mx7ulp:"

require conf/machine/include/imx-base.inc
require conf/machine/include/arm/armv7a/tune-cortexa7.inc

SERIAL_CONSOLES = "115200;ttyLP0"

MACHINE_FEATURES += " pci bluetooth optee"

PREFERRED_PROVIDER_virtual/kernel = "linux-lmp-fslc-imx"

KERNEL_DEVICETREE = "imx7ulp-evkb.dtb"

IMX_DEFAULT_BOOTLOADER = "u-boot-fio"
PREFERRED_PROVIDER_u-boot-default-script ?= "u-boot-base-scr"

SPL_BINARY = "SPL"
UBOOT_CONFIG ??= "sd"
UBOOT_CONFIG[sd] = "mx7ulp_evk_defconfig"

UBOOT_SUFFIX = "bin"
UBOOT_MAKE_TARGET = ""

WKS_FILE_DEPENDS:append = " u-boot-default-script"
```
